&mdss_mdp {
	dsi_sh8804b_mz_amoled_fhd_plus_cmd: qcom,mdss_dsi_sh8804b_mz_amoled_fhd_plus_cmd {
		qcom,mdss-dsi-panel-name = "sh8804b fhd plus amoled cmd panel";
		qcom,mdss-dsi-panel-type = "dsi_cmd_mode";
		qcom,mdss-dsi-panel-physical-type = "oled";

		qcom,dsi-ctrl-num = <0>;
		qcom,dsi-phy-num = <0>;

		qcom,mdss-dsi-virtual-channel-id = <0>;
		qcom,mdss-dsi-stream = <0>;
		qcom,mdss-dsi-bpp = <24>;
		qcom,mdss-dsi-color-order = "rgb_swap_rgb";
		qcom,mdss-dsi-underflow-color = <0xff>;
		qcom,mdss-dsi-border-color = <0>;
		qcom,mdss-dsi-traffic-mode = "burst_mode";
		qcom,mdss-dsi-lane-map = "lane_map_0123";
		qcom,mdss-dsi-bllp-eof-power-mode;
		qcom,mdss-dsi-bllp-power-mode;
		qcom,mdss-dsi-lane-0-state;
		qcom,mdss-dsi-lane-1-state;
		qcom,mdss-dsi-lane-2-state;
		qcom,mdss-dsi-lane-3-state;
		qcom,mdss-dsi-dma-trigger = "trigger_sw";
		qcom,mdss-dsi-mdp-trigger = "none";
		qcom,mdss-dsi-reset-sequence = <1 20>, <0 10>, <1 20>;
		qcom,mdss-dsi-tx-eot-append;

		qcom,mdss-dsi-te-pin-select = <1>;
		qcom,mdss-dsi-te-dcs-command = <1>;
		qcom,mdss-dsi-te-check-enable;
		qcom,mdss-dsi-te-using-te-pin;

		qcom,mdss-dsi-display-timings {
			timing@0 {
				qcom,mdss-dsi-panel-framerate = <60>;
				qcom,mdss-dsi-panel-width = <1080>;
				qcom,mdss-dsi-panel-height = <2400>;
				qcom,mdss-dsi-h-front-porch = <16>;
				qcom,mdss-dsi-h-back-porch = <8>;
				qcom,mdss-dsi-h-pulse-width = <8>;
				qcom,mdss-dsi-h-sync-skew = <0>;
				qcom,mdss-dsi-v-back-porch = <8>;
				qcom,mdss-dsi-v-front-porch = <28>;
				qcom,mdss-dsi-v-pulse-width = <8>;
				qcom,mdss-dsi-h-left-border = <0>;
				qcom,mdss-dsi-h-right-border = <0>;
				qcom,mdss-dsi-v-top-border = <0>;
				qcom,mdss-dsi-v-bottom-border = <0>;
				//qcom,mdss-dsi-panel-jitter = <0x4 0x1>;
				qcom,mdss-dsi-on-command = [
					39 01 00 00 00 00 03 F0 3C 3C
					39 01 00 00 00 00 03 F1 3C 3C
					39 01 00 00 00 00 03 FF 3C 00
					39 01 00 00 00 00 05 D0 00 00 00 01
					39 01 00 00 00 00 04 B4 00 00 00
					39 01 00 00 00 00 09 B5 00 40 0A 00 00 C0 0A 00
					39 01 00 00 00 00 03 B7 21 76
					39 01 00 00 00 00 10 C1 02 0C 10 10 44 20 00 00 00 00 00 08 00 00 85
					39 01 00 00 00 00 03 FF 3C 01
					39 01 00 00 00 00 06 B0 50 10 10 15 20
					39 01 00 00 00 00 3B B1 44 60 09 38 04 D0 02 00 00 00 01 03 00 10 07 30 00 50 00 5A 00 10 00 10 00 18 00 68 00 10 00 10 00 5A 00 5A 00 10 09 60 00 5A 00 5A 00 11 00 00 37 04 00 00 23 09 00 00 FF 00
					39 01 00 00 00 00 17 B2 14 14 03 04 03 04 03 04 07 13 14 14 03 04 03 04 03 04 13 14 14 03
					39 01 00 00 00 00 1B B3 40 01 38 A5 C9 00 30 01 C0 A6 41 00 01 00 00 00 00 11 20 44 35 77 86 AA 9B FF
					39 01 00 00 00 00 06 B4 32 22 26 56 12
					39 01 00 00 00 00 13 B5 00 00 00 00 00 00 04 F0 20 00 00 00 00 00 00 00 00 00
					39 01 00 00 00 00 31 B7 00 FB FC 00 00 00 00 00 00 00 00 00 00 00 00 00 00 00 00 00 00 00 00 00 00 00 00 00 00 00 00 00 00 00 00 00 00 00 00 00 00 00 00 00 00 00 00 00
					39 01 00 00 00 00 0A B8 09 AA 55 AA 55 AA 55 AA 55
					39 01 00 00 00 00 29 BA 24 00 27 00 26 00 0C 00 0B 00 01 00 37 37 37 37 24 00 27 00 26 00 0C 00 0B 00 01 00 37 37 37 37 00 00 00 00 00 00 00 00
					39 01 00 00 00 00 19 BB 00 02 00 00 00 2B 00 00 00 00 79 79 00 00 79 79 00 00 79 79 00 00 79 79
					39 01 00 00 00 00 1B BC 8B 01 00 0E 00 0B 00 0A 00 0C 00 0C 00 0E 01 AE 00 01 AE 00 01 AE 00 01 AE 00
					39 01 00 00 00 00 13 BE 03 50 00 0E 04 00 12 12 00 12 12 00 12 12 00 12 12 00
					39 01 00 00 00 00 12 C0 11 01 00 10 10 64 90 10 64 90 10 64 90 10 64 90 FF
					39 01 00 00 00 00 12 C5 21 02 00 31 00 12 AA 00 12 AA 00 12 AA 00 12 AA FF
					39 01 00 00 00 00 11 C7 66 00 66 00 66 00 00 00 00 66 00 11 00 00 00 00
					39 01 00 00 00 00 32 C8 00 00 00 00 00 00 00 00 06 06 06 00 60 10 00 00 00 00 06 20 00 00 00 00 00 00 00 00 00 00 00 00 00 00 00 00 00 00 00 00 00 00 00 00 00 00 00 00 FF
					39 01 00 00 00 00 63 C9 00 00 25 21 36 00 00 00 56 11 00 00 00 00 00 00 00 00 00 00 00 00 00 00 25 31 26 00 00 00 56 11 00 00 00 00 00 00 00 00 00 00 00 00 00 00 35 12 36 56 12 00 00 00 00 00 00 00 00 00 00 00 00 00 00 00 00 00 00 00 00 35 22 26 00 00 00 56 12 00 00 00 00 00 00 00 00 00 00 00 00 00 00 35 21 26 56 11
					39 01 00 00 00 00 17 CE 01 30 03 03 03 03 03 03 03 03 00 00 02 02 02 00 00 00 00 00 00 FF
					39 01 00 00 00 00 03 FF 3C 02
					39 01 00 00 00 00 1F B0 09 88 08 58 0A 54 1E 1E 19 1B 46 10 1E 00 38 77 6C 6C 33 33 33 33 73 33 33 33 32 04 F0 33
					39 01 00 00 00 00 2C B2 00 00 77 19 21 29 01 03 05 07 07 08 09 0A 0D 0F 21 25 25 1C 00 77 19 21 29 01 03 05 07 08 09 0A 0B 0D 0F 25 21 21 00 00 00 00 FF
					39 01 00 00 00 00 29 B3 00 00 00 00 01 01 02 03 03 07 04 04 05 06 07 07 08 08 09 09 09 09 09 8B 8C 09 0A 09 0B 0C 0C 0C 00 0E 18 1C 00 00 21 00
					39 01 00 00 00 00 29 B3 00 00 00 00 01 01 02 03 03 07 04 04 05 06 07 07 08 08 09 09 09 09 09 8B 8C 09 0A 09 0B 0C 0C 0C 00 0E 14 18 00 00 21 00
					39 01 00 00 00 00 17 B4 BB BB B0 AA 9A 88 88 78 77 77 77 77 77 77 77 88 08 EC 44 00 21 00
					39 01 00 00 00 00 17 B5 22 22 20 11 11 11 11 00 00 00 00 00 00 00 00 00 00 02 00 00 00 FF
					39 01 00 00 00 00 20 BA 0F 0F 0F 0F 0F 0F 0F 0F 0F 0F 0F 0F 14 15 16 17 18 19 19 19 19 19 19 19 0F 0F 0F 19 19 19 00
					39 01 00 00 00 00 03 FF 3C 03
					39 01 00 00 00 00 A7 B0 00 00 FF 04 00 00 00 00 00 00 00 00 00 00 00 00 00 00 00 00 00 00 09 00 06 00 10 00 13 00 0D 00 20 00 1C 00 13 00 30 00 39 00 27 00 61 00 56 00 3B 00 92 00 73 00 4F 00 C3 00 A2 00 70 00 14 01 D2 00 92 00 66 01 02 01 B3 00 B7 01 5A 01 F0 00 4B 02 5F 01 F5 00 50 02 64 01 FA 00 55 02 72 01 08 01 63 02 84 01 1A 01 75 02 9A 01 30 01 8B 02 B4 01 4A 01 A5 02 C2 01 58 01 B3 02 CA 01 60 01 BB 02 D3 01 69 01 C4 02 DE 01 73 01 CF 02 E9 01 7F 01 DA 02 F6 01 8B 01 E7 02 04 02 99 01 F5 02 13 02 A8 01 04 03
					39 01 00 00 00 00 A7 B1 00 00 FF 04 00 00 00 00 00 00 09 00 06 00 10 00 69 00 49 00 B3 00 62 01 F8 00 53 02 84 01 1A 01 75 02 B8 01 4E 01 A9 02 CD 01 62 01 BE 02 E3 01 78 01 D4 02 FE 01 93 01 EF 02 1F 02 B3 01 10 03 45 02 D9 01 36 03 62 02 F1 01 53 03 A1 02 24 02 93 03 EF 02 63 02 E2 03 22 03 8F 02 19 04 8B 03 ED 02 8D 04 DE 03 3F 03 EF 04 37 04 8C 03 4F 05 84 04 D0 03 A3 05 C5 04 0C 04 ED 05 02 05 45 04 34 06 3B 05 7B 04 73 06 70 05 AC 04 AE 06 A0 05 DA 04 E5 06 CF 05 08 05 1A 07 01 06 3A 05 53 07 2A 06 5F 05 81 07
					39 01 00 00 00 00 A7 B2 00 00 FF 04 00 00 00 00 00 00 13 00 0D 00 20 00 DC 00 98 00 76 01 78 01 0E 01 69 02 BD 01 53 01 AE 02 D7 01 6D 01 C8 02 FC 01 91 01 ED 02 2A 02 BF 01 1B 03 5A 02 EB 01 4B 03 83 02 0D 02 75 03 B4 02 33 02 A7 03 EB 02 60 02 DF 03 34 03 9F 02 2D 04 83 03 E5 02 82 04 BA 03 1B 03 C4 04 36 04 8B 03 4E 05 9F 04 E8 03 C1 05 F6 04 39 04 25 06 47 05 86 04 80 06 8F 05 C9 04 D1 06 CF 05 08 05 1A 07 12 06 49 05 66 07 4D 06 7F 05 A9 07 88 06 B4 05 EB 07 BF 06 E8 05 29 08 F0 06 16 06 60 08 1F 07 41 06 95 08
					39 01 00 00 00 00 A7 B3 00 00 FF 04 00 00 00 00 00 00 26 00 1A 00 41 00 5A 01 F0 00 4B 02 97 01 2D 01 88 02 D1 01 67 01 C2 02 FF 01 94 01 F0 02 3E 02 D3 01 2F 03 75 02 01 02 67 03 B2 02 32 02 A4 03 FA 02 6C 02 EE 03 24 03 91 02 1B 04 54 03 BB 02 4F 04 A8 03 0A 03 AF 04 F7 03 55 03 0A 05 4A 04 9C 03 62 05 C5 04 0B 04 ED 05 2F 05 70 04 66 06 8F 05 C9 04 D2 06 E3 05 1D 05 31 07 34 06 68 05 8C 07 82 06 AF 05 E4 07 C8 06 F1 05 34 08 05 07 29 06 78 08 44 07 64 06 BF 08 89 07 A4 06 0D 09 C0 07 D6 06 49 09 FA 07 0C 07 8B 09
					39 01 00 00 00 00 A7 B4 00 00 FF 04 00 00 00 00 00 00 39 00 27 00 61 00 61 01 F7 00 52 02 BF 01 55 01 B0 02 F0 01 86 01 E1 02 3D 02 D1 01 2E 03 82 02 0C 02 74 03 D5 02 4E 02 C8 03 19 03 88 02 10 04 55 03 BC 02 51 04 8F 03 F1 02 91 04 BD 03 1E 03 C8 04 21 04 7A 03 38 05 7E 04 CA 03 9C 05 C8 04 0E 04 F0 05 4E 05 8C 04 87 06 BC 05 F6 04 05 07 26 06 5B 05 7C 07 87 06 B3 05 E9 07 DE 06 05 06 4C 08 2A 07 4C 06 A2 08 80 07 9B 06 02 09 C6 07 DC 06 51 09 12 08 22 07 A5 09 56 08 60 07 F4 09 99 08 9C 07 43 0A DB 08 D7 07 8F 0A
					39 01 00 00 00 00 A7 B5 00 00 FF 04 00 00 00 00 00 00 4C 00 35 00 82 00 67 01 FD 00 58 02 C9 01 5F 01 BA 02 0A 02 9F 01 FB 02 61 02 F1 01 53 03 B6 02 35 02 A9 03 0E 03 7E 02 04 04 51 03 B8 02 4C 04 92 03 F4 02 95 04 C7 03 28 03 D4 04 00 04 5D 03 14 05 70 04 BE 03 8D 05 C4 04 0B 04 EC 05 12 05 54 04 45 06 9B 05 D5 04 DF 06 15 06 4C 05 69 07 83 06 B0 05 E5 07 E5 06 0B 06 54 08 3D 07 5D 06 B7 08 9B 07 B4 06 20 09 EC 07 FF 06 7B 09 40 08 4C 07 D9 09 8A 08 8F 07 31 0A D6 08 D3 07 8A 0A 1D 09 13 08 DB 0A 65 09 54 08 2E 0B
					39 01 00 00 00 00 A7 B6 00 00 FF 04 00 00 00 00 00 00 56 00 3B 00 92 00 6C 01 02 01 5D 02 CF 01 65 01 C0 02 1B 02 B0 01 0C 03 75 02 01 02 67 03 D8 02 50 02 CB 03 28 03 94 02 1F 04 75 03 D8 02 73 04 AE 03 10 03 B6 04 EB 03 4C 03 FE 04 28 04 7F 03 3F 05 93 04 DE 03 B4 05 EA 04 2F 04 18 06 3B 05 7B 04 73 06 C4 05 FE 04 0E 07 42 06 75 05 9D 07 B4 06 DE 05 1C 08 15 07 38 06 89 08 7B 07 97 06 FD 08 D2 07 E8 06 5E 09 30 08 3D 07 C6 09 7E 08 84 07 22 0A D0 08 CE 07 83 0A 1B 09 11 08 D9 0A 69 09 57 08 31 0B B5 09 9B 08 88 0B
					39 01 00 00 00 00 A7 B7 00 00 FF 04 00 00 00 00 00 00 69 00 49 00 B3 00 71 01 07 01 62 02 D8 01 6E 01 C9 02 33 02 C8 01 24 03 93 02 19 02 85 03 01 03 72 02 F6 03 4D 03 B5 02 48 04 98 03 F9 02 9B 04 D7 03 38 03 E7 04 19 04 73 03 2F 05 60 04 AF 03 7B 05 C2 04 09 04 E9 05 1B 05 5D 04 4F 06 6E 05 AA 04 AC 06 01 06 3A 05 52 07 81 06 AE 05 E3 07 F0 06 16 06 61 08 5B 07 79 06 D8 08 C0 07 D6 06 49 09 24 08 33 07 BA 09 7B 08 81 07 1F 0A D4 08 D1 07 87 0A 26 09 1B 08 E6 0A 79 09 65 08 44 0B CE 09 B1 08 A5 0B 1C 0A F3 08 FF 0B
					39 01 00 00 00 00 A7 B8 00 00 FF 04 00 00 00 00 00 00 86 00 5C 00 E3 00 7A 01 10 01 6B 02 E4 01 7A 01 D5 02 51 02 E4 01 42 03 BB 02 39 02 AE 03 23 03 90 02 1A 04 80 03 E2 02 7F 04 C1 03 22 03 CC 04 09 04 65 03 1E 05 58 04 A8 03 72 05 8F 04 DA 03 AF 05 F7 04 3B 04 27 06 55 05 93 04 90 06 A7 05 E0 04 EC 06 3E 06 71 05 98 07 C6 06 EF 05 31 08 37 07 58 06 B1 08 AC 07 C4 06 33 09 18 08 28 07 AC 09 79 08 7F 07 1D 0A DA 08 D7 07 8E 0A 36 09 29 08 F8 0A 90 09 7A 08 5F 0B EC 09 CB 08 C7 0B 43 0A 14 09 2B 0C 9A 0A 5E 09 8F 0C
					39 01 00 00 00 00 A7 B9 00 00 FF 04 00 00 00 00 00 00 AC 00 77 00 25 01 86 01 1C 01 77 02 F7 01 8C 01 E8 02 6F 02 FC 01 61 03 F6 02 69 02 EA 03 54 03 BC 02 50 04 AB 03 0C 03 B2 04 FB 03 59 03 0F 05 51 04 A2 03 6A 05 91 04 DC 03 B2 05 CC 04 12 04 F5 05 3A 05 7A 04 71 06 99 05 D3 04 DD 06 F1 05 2B 05 41 07 8F 06 BC 05 F3 07 15 07 38 06 8A 08 9A 07 B3 06 1F 09 11 08 21 07 A4 09 7F 08 85 07 24 0A EA 08 E5 07 A0 0A 52 09 43 08 18 0B B7 09 9D 08 8A 0B 1A 0A F1 08 FB 0B 7C 0A 44 09 6D 0C DF 0A 99 09 DE 0C 40 0B F0 09 4E 0D
					39 01 00 00 00 00 A7 BA 00 00 FF 04 00 00 00 00 00 00 02 01 B3 00 B7 01 A2 01 38 01 93 02 22 02 B7 01 13 03 B6 02 36 02 A9 03 3E 03 A8 02 37 04 AA 03 0B 03 B1 04 0B 04 66 03 20 05 6D 04 BB 03 89 05 B7 04 FF 03 DD 05 FB 04 3E 04 2C 06 3B 05 7B 04 73 06 AB 05 E5 04 F2 06 15 06 4C 05 69 07 76 06 A4 05 D7 07 18 07 3B 06 8D 08 B4 07 CB 06 3C 09 44 08 4F 07 DE 09 C8 08 C6 07 79 0A 43 09 35 08 07 0B BE 09 A3 08 92 0B 35 0A 07 09 1A 0C AB 0A 6C 09 A2 0C 21 0B D4 09 2A 0D 96 0B 39 0A AF 0D 09 0C 99 0A 31 0E 7D 0C FF 0A BE 0E
					39 01 00 00 00 00 A7 BB 00 00 FF 04 00 00 00 00 00 00 59 01 EF 00 4A 02 BD 01 53 01 AE 02 4C 02 E0 01 3D 03 FA 02 6C 02 EE 03 80 03 E2 02 7F 04 E9 03 4A 03 FC 04 5E 04 AD 03 78 05 B2 04 FA 03 D7 05 FF 04 42 04 30 06 48 05 87 04 81 06 8A 05 C4 04 CC 06 03 06 3C 05 55 07 71 06 9F 05 D1 07 D4 06 FC 05 41 08 88 07 A3 06 0B 09 2C 08 3A 07 C2 09 C1 08 C0 07 71 0A 4D 09 3E 08 12 0B D9 09 BB 08 B1 0B 5F 0A 2B 09 4B 0C E5 0A 9E 09 E5 0C 6B 0B 17 0A 80 0D ED 0B 80 0A 0F 0E 6F 0C F4 0A AE 0E FE 0C 65 0B 4F 0F 84 0D D4 0B EA 0F
					39 01 00 00 00 00 A7 BD 00 00 FF 06 00 00 00 00 00 00 97 00 8A 00 CC 00 7E 02 47 02 51 03 34 03 EB 02 F6 03 56 03 0C 03 18 04 7D 03 2E 03 3B 04 A1 03 48 03 55 04 BD 03 5F 03 6D 04 D2 03 74 03 81 04 E7 03 8A 03 9E 04 FF 03 A2 03 C2 04 1C 04 BE 03 E2 04 57 04 EE 03 1C 05 89 04 18 04 4E 05 B7 04 40 04 7F 05 01 05 7C 04 CF 05 49 05 BE 04 1E 06 8F 05 FD 04 6D 06 CA 05 34 05 AF 06 00 06 65 05 EA 06 30 06 93 05 21 07 60 06 C2 05 59 07 8A 06 EA 05 8A 07 B6 06 14 06 BB 07 DB 06 36 06 E5 07 01 07 59 06 11 08 23 07 7A 06 38 08
					39 01 00 00 00 00 A7 BE 00 00 FF 06 00 00 00 00 00 00 2E 01 14 01 99 01 BA 02 7D 02 87 03 48 03 FF 02 0A 04 7D 03 2E 03 3C 04 B1 03 54 03 62 04 CC 03 6E 03 7C 04 EA 03 8D 03 A2 04 0D 04 AF 03 D2 04 39 04 D9 03 FF 04 5D 04 F3 03 22 05 80 04 0F 04 45 05 BF 04 47 04 87 05 F1 04 6E 04 BE 05 24 05 9C 04 F5 05 83 05 F3 04 60 06 D4 05 3D 05 BA 06 1D 06 81 05 0B 07 5D 06 BF 05 56 07 97 06 F7 05 98 07 CF 06 2B 06 D7 07 03 07 5B 06 13 08 32 07 89 06 49 08 5F 07 B3 06 7C 08 8A 07 DB 06 AD 08 B5 07 01 07 DD 08 DE 07 29 07 0A 09
					39 01 00 00 00 00 A7 BF 00 00 FF 04 00 00 00 00 00 00 5C 02 28 02 32 03 2D 03 E5 02 EF 03 70 03 25 03 32 04 B3 03 55 03 63 04 D9 03 7B 03 88 04 04 04 A7 03 C9 04 40 04 DF 03 06 05 70 04 00 04 35 05 9F 04 2C 04 64 05 C7 04 4E 04 90 05 E9 04 66 04 B5 05 2E 05 A6 04 00 06 6F 05 E0 04 49 06 B1 05 1D 05 93 06 14 06 78 05 00 07 6B 06 CD 05 67 07 BB 06 19 06 C0 07 01 07 59 06 11 08 42 07 99 06 5B 08 7E 07 D0 06 9F 08 B8 07 04 07 E0 08 F0 07 3B 07 1F 09 23 08 6A 07 59 09 56 08 9A 07 93 09 87 08 C7 07 CA 09 B4 08 EE 07 FE 09
					39 01 00 00 00 00 A7 BC 00 00 FF 04 00 00 00 00 00 00 7E 02 8A 02 C6 03 D6 02 CC 02 1E 04 62 03 6D 03 AB 04 08 04 F9 03 64 05 89 04 67 04 EC 05 F3 04 C6 04 5C 06 5F 05 25 05 DD 06 A9 05 64 05 23 07 F2 05 A6 05 70 07 36 06 E1 05 B4 07 76 06 1A 06 F4 07 E3 06 7A 06 5F 08 46 07 D3 06 C0 08 A1 07 24 07 19 09 43 08 B4 07 B9 09 D4 08 33 08 53 0A 59 09 AA 08 E6 0A D7 09 18 09 73 0B 51 0A 83 09 FD 0B C2 0A E4 09 83 0C 34 0B 44 0A 03 0D A4 0B A2 0A 82 0D 17 0C 01 0B 03 0E 83 0C 5E 0B 82 0E F6 0C B9 0B 01 0F 67 0D 17 0C 82 0F
					39 01 00 00 00 00 A7 E4 00 00 FF 04 00 00 00 00 00 00 59 01 EF 00 4A 02 BD 01 53 01 AE 02 4C 02 E0 01 3D 03 FA 02 6C 02 EE 03 80 03 E2 02 7F 04 E9 03 4A 03 FC 04 5E 04 AD 03 78 05 B2 04 FA 03 D7 05 FF 04 42 04 30 06 48 05 87 04 81 06 8A 05 C4 04 CC 06 03 06 3C 05 55 07 71 06 9F 05 D1 07 D4 06 FC 05 41 08 88 07 A3 06 0B 09 2C 08 3A 07 C2 09 C1 08 C0 07 71 0A 4D 09 3E 08 12 0B D9 09 BB 08 B1 0B 5F 0A 2B 09 4B 0C E5 0A 9E 09 E5 0C 6B 0B 17 0A 80 0D ED 0B 80 0A 0F 0E 6F 0C F4 0A AE 0E FE 0C 65 0B 4F 0F 84 0D D4 0B EA 0F
					39 01 00 00 00 00 03 FF 3C 04
					39 01 00 00 00 00 2C B2 00 0A 77 66 55 44 33 22 11 11 10 00 00 00 00 00 FF 7E FE 7E FD 7D FD 7D FC 7C FC 7C FB BB 7B 3A 1A FA DA BB 99 79 59 38 18 08 FE
					39 01 00 00 00 00 09 B3 0C 02 3C 00 00 00 00 00
					39 01 00 00 00 00 03 FF 3C 05
					39 01 00 00 00 00 17 B1 F0 01 BE 08 26 02 6E 08 DC 56 00 00 00 00 00 00 00 00 00 00 00 00
					39 01 00 00 00 00 03 FF 3C 0A
					39 01 00 00 00 00 15 B0 00 00 10 00 00 00 00 00 00 00 00 00 00 00 00 00 00 00 00 00
					39 01 00 00 00 00 03 FF 3C 0E
					39 01 00 00 00 00 07 B0 33 00 60 09 38 04
					39 01 00 00 00 00 11 B1 55 00 00 00 44 00 44 40 04 40 04 40 04 19 00 00
					39 01 00 00 00 00 11 B2 41 34 00 f3 37 00 44 30 3f 40 04 40 04 19 00 00
					39 01 00 00 00 00 11 B3 49 00 99 00 48 17 5f 80 04 70 91 80 04 19 00 00
					39 01 00 00 00 00 11 B4 4d 34 99 ef 37 17 5f f0 3e 70 91 80 04 19 00 00
					39 01 00 00 00 00 11 B5 03 12 00 f4 44 0f 55 c0 21 20 03 e0 01 00 00 00
					39 01 00 00 00 00 11 B6 10 22 00 99 ab 00 12 b0 2a 20 01 20 01 00 00 00
					39 01 00 00 00 00 11 B7 4a 11 00 9d dc 12 52 c0 1d 20 01 e0 03 0a 00 00
					39 01 00 00 00 00 11 B8 42 22 00 5c 9a 12 52 c0 25 20 01 e0 03 0a 00 00
					39 01 00 00 00 00 11 B9 84 12 00 c8 1b 00 14 70 1c 50 01 60 01 01 00 00
					39 01 00 00 00 00 11 BA 88 22 00 1c 6f 00 14 f0 26 40 01 50 01 01 00 00
					39 01 00 00 00 00 39 BB 03 03 00 45 f2 00 00 01 10 10 10 00 00 00 05 00 09 00 00 45 16 01 10 10 10 00 00 00 07 44 09 37 37 45 16 01 10 10 10 00 00 00 01 03 99 49 ee 5f 5f 01 10 10 10 00 00 00
					39 01 00 00 00 00 39 BC 02 12 00 dd 5b 51 51 01 20 20 20 20 20 20 12 00 11 be d2 36 36 aa 20 20 20 20 20 20 02 00 11 be d2 40 40 ff 20 20 00 00 00 00 12 00 11 be d2 4a 4a ff 20 20 20 20 00 00
					39 01 00 00 00 00 39 BD 00 04 aa a3 0c 4f 4f 01 10 10 10 00 00 00 16 44 09 af af b5 a2 01 10 10 10 00 00 00 02 00 11 be d2 68 68 ed 10 10 20 20 10 10 06 11 00 f4 f4 be d2 ff 80 10 00 00 00 00
					39 01 00 00 00 00 39 BE 02 04 00 00 f0 00 00 01 80 00 80 00 80 00 00 04 55 00 f0 ff ff 01 80 00 80 00 80 00 04 55 05 03 03 13 ec 01 40 00 80 00 80 00 06 22 00 1c 1c be d2 eb 0c 20 80 10 0e 0d
					39 01 00 00 00 00 39 BF 16 22 00 26 26 be d2 9c 13 40 25 0f 63 21 06 22 00 30 30 be d2 ff 21 10 42 10 63 10 02 00 00 64 64 f9 f9 ff 20 20 20 20 20 20 12 00 00 6e 6e f9 f9 ff 20 20 20 20 20 20
					39 01 00 00 00 00 39 C0 12 11 00 2c 2c f7 f7 ff 40 10 40 20 40 10 02 11 00 36 36 f7 f7 ff 14 20 14 10 14 20 16 33 00 1b 1b c8 c8 ff 20 20 20 20 20 20 14 33 00 1b 1b d2 d2 ff 20 20 20 20 20 20
					39 01 00 00 00 00 41 C1 00 01 02 03 04 06 07 08 09 0a 0c 0d 0e 0f 10 12 13 14 15 16 18 19 1a 1b 1c 1e 1f 20 21 22 24 25 26 27 28 2a 2b 2c 2d 2e 30 31 32 33 34 36 37 38 39 3a 3c 3d 3e 3f 40 42 43 44 45 46 48 49 4a 4b
					39 01 00 00 00 00 41 C2 00 00 00 00 00 00 00 00 00 00 00 00 00 00 00 00 00 00 00 00 00 00 00 00 00 00 00 00 00 00 00 00 00 00 00 00 00 00 00 00 00 00 00 00 00 00 00 00 00 00 00 00 00 00 00 00 00 00 00 00 00 00 00 00
					39 01 00 00 00 00 41 C3 00 02 05 08 0b 0e 10 13 16 19 1c 1e 21 24 27 2a 2c 2f 32 35 38 3a 3d 40 43 46 48 4b 4e 51 54 56 59 5c 5f 62 64 67 6a 6d 70 72 75 78 7b 7d 80 83 86 89 8c 8e 91 94 97 9a 9c 9f a2 a5 a8 aa ad b0
					39 01 00 00 00 00 41 C4 00 03 07 0a 0e 12 15 19 1c 20 24 27 2b 2e 32 36 39 3d 40 44 48 4b 4f 52 56 5a 5d 61 64 68 6c 6f 73 76 7a 7e 81 85 88 8c 90 93 97 9a 9e a2 a5 a9 ac b0 b4 b7 bb be c2 c6 c9 cd d0 d4 d8 db df e2
					39 01 00 00 00 00 41 C5 00 04 08 0c 10 14 18 1c 20 24 28 2c 30 34 38 3c 40 44 48 4c 50 54 58 5c 60 64 68 6c 70 74 78 7c 80 84 88 8c 90 94 98 9c a0 a4 a8 ac b0 b4 b8 bc c0 c4 c8 cc d0 d4 d8 dc e0 e4 e8 ec f0 f4 f8 fc
					39 01 00 00 00 00 41 C6 00 00 00 00 00 00 01 01 02 03 04 05 06 07 09 0a 0c 0d 0f 11 13 16 18 1b 1d 20 23 26 29 2d 30 34 37 3b 3f 44 48 4d 51 56 5b 60 65 6b 70 76 7c 82 88 8e 95 9c a2 a9 b0 b8 bf c7 cf d7 df e7 ef f8
					39 01 00 00 00 00 41 C7 00 26 34 3f 48 50 57 5d 63 68 6d 72 77 7b 80 84 88 8b 8f 93 96 99 9d a0 a3 a6 a9 ac af b2 b5 b7 ba bd bf c2 c4 c7 c9 cb ce d0 d2 d5 d7 d9 db de e0 e2 e4 e6 e8 ea ec ee f0 f2 f4 f6 f8 f9 fb fd
					39 01 00 00 00 00 41 C8 00 12 1d 25 2d 33 3a 40 45 4b 50 55 59 5e 62 67 6b 6f 73 77 7b 7f 83 86 8a 8e 91 95 98 9b 9f a2 a5 a8 ac af b2 b5 b8 bb be c1 c4 c7 ca cd cf d2 d5 d8 db dd e0 e3 e5 e8 eb ed f0 f2 f5 f8 fa fd
					39 01 00 00 00 00 51 C9 00 00 00 00 00 00 50 55 55 55 55 55 55 aa aa aa 00 0a 14 1e 28 32 3c 46 50 5a 64 6e 78 82 8c 96 a0 aa b4 be c8 d2 dc e6 f0 fa 04 0e 18 22 2c 36 40 4a 54 5e 68 72 7c 86 90 9a a4 ae b8 c2 cc d6 e0 ea f4 fe 08 12 1c 26 30 3a 44 4e 58 62 6c 76
					39 01 00 00 00 00 51 CA aa aa aa fe ff ff ff ff ff ff ff ff ff ff ff ff 80 8a 94 9e a8 b2 bc c6 d0 da e4 ee f8 02 0c 16 20 2a 34 3e 48 52 5c 66 70 7a 84 8e 98 a2 ac b6 c0 ca d4 de e8 f2 fc ff ff ff ff ff ff ff ff ff ff ff ff ff ff ff ff ff ff ff ff ff ff ff ff ff
					39 01 00 00 00 00 79 CB ff 5a 01 00 00 00 00 00 00 00 00 00 00 00 00 00 00 00 00 00 00 00 00 00 ff e8 84 20 bc 58 f4 90 2c c8 64 00 00 00 00 00 00 00 00 00 00 00 00 00 00 00 00 00 00 00 00 00 00 00 00 00 00 00 00 00 00 00 00 00 00 00 00 00 00 00 00 00 00 00 00 00 00 00 00 00 00 00 00 00 00 00 00 00 00 00 00 00 00 00 00 00 00 00 00 00 00 00 00 00 00 00 00 00 00 00 00 00 00 00 00 00
					39 01 00 00 00 00 29 CC 00 00 00 00 00 00 00 00 00 02 04 06 08 0a 0c 0e 10 12 14 16 18 1a 1c 1e 20 22 24 26 28 2a 2c 2e 30 32 34 36 38 3a 3c 3e
					39 01 00 00 00 00 19 CD 00 00 00 00 00 00 00 00 00 00 00 00 00 00 00 00 00 00 00 00 00 00 00 00
					39 01 00 00 00 00 03 FF 3C 0F
					39 01 00 00 00 00 4B B0 00 01 00 72 00 F0 01 A4 02 BC 03 A2 04 38 05 14 06 40 07 FF 0C 1C 0F FF 07 FF 0F FF 03 FF 07 FF 0F FF 00 00 00 00 00 00 00 00 00 00 00 00 00 00 00 00 00 00 00 00 00 00 00 00 00 00 00 00 00 00 00 00 00 00 00 00 00 00 03 FF
					39 01 00 00 00 00 30 B1 00 00 01 00 72 00 F0 01 A4 02 BC 03 A2 04 38 05 14 06 40 0F FF 0F FF 07 FF 0F FF 03 FF 07 FF 0F FF 0F FF 0F FF 0F FF 0F FF 0F FF 00 00 00 00
					39 01 00 00 00 00 65 B2 00 00 0E 10 0E 10 0E 10 0E 10 0E 10 0E 10 0E 10 0E 10 0E 10 0E 10 0E 10 0E 10 00 00 09 C4 09 C4 09 C4 09 C4 09 C4 09 C4 09 C4 09 C4 09 C4 09 C4 09 C4 09 C4 00 00 09 C4 09 C4 09 C4 09 C4 09 C4 09 C4 09 C4 09 C4 09 C4 09 C5 09 C4 09 C4 00 00 09 C4 09 C4 09 C4 09 C4 09 C4 09 C4 09 C4 09 C4 09 C4 09 C4
					39 01 00 00 00 00 27 B3 00 00 00 00 00 00 00 00 08 08 08 08 08 08 08 08 08 08 08 08 08 08 08 08 08 08 08 08 08 08 08 08 08 08 08 08 00 C0
					39 01 00 00 00 00 14 B4 01 02 07 01 5A 50 46 99 03 33 03 CC 02 33 00 66 00 99 00
					39 01 00 00 00 00 2E B5 0B 03 04 46 00 64 00 32 00 04 04 10 80 24 24 4C 2B 00 00 35 01 4C 00 00 00 00 00 24 24 00 00 00 00 06 00 00 00 24 02 00 55 55 00 00 00
					39 01 00 00 00 00 24 B6 00 01 01 23 45 67 01 23 45 67 05 04 03 02 01 00 00 00 00 00 00 00 00 00 00 00 00 00 00 00 00 00 00 00 00
					39 01 00 00 00 00 03 FF 3C 10
					39 01 00 00 00 00 09 B0 15 60 09 38 04 0e 01 00
					39 01 00 00 00 00 4C B1 00 00 00 00 00 00 00 03 01 00 00 03 41 17 00 00 01 17 09 00 00 00 00 00 00 00 00 00 00 00 00 00 03 01 00 00 03 41 17 00 00 01 17 09 00 00 00 00 00 00 00 00 00 00 00 00 09 17 01 00 00 17 41 03 00 00 01 03 00 00 00 00 00 00 00
					39 01 00 00 00 00 4C B2 00 00 00 00 00 00 09 17 01 00 00 17 41 03 00 00 01 03 00 00 00 00 00 00 00 00 00 00 00 00 00 00 03 01 00 00 03 41 17 00 00 01 17 09 00 00 00 00 00 00 00 00 00 00 00 00 00 03 01 00 00 03 41 17 00 00 01 17 09 00 00 00 00 00 00
					39 01 00 00 00 00 4C B3 00 00 00 00 00 00 09 17 01 00 00 17 41 03 00 00 01 03 00 00 00 00 00 00 00 00 00 00 00 00 00 00 03 01 00 00 03 41 17 00 00 01 17 09 00 00 00 00 00 00 00 00 00 00 00 00 00 03 01 00 00 03 41 17 00 00 01 17 09 00 00 00 00 00 00
					39 01 00 00 00 00 4C B4 00 00 00 00 00 00 00 03 01 00 00 03 41 17 00 00 01 17 09 00 00 00 00 00 00 00 00 00 00 00 00 00 03 01 00 00 03 41 17 00 00 01 17 09 00 00 00 00 00 00 00 00 00 00 00 00 09 17 01 00 00 17 41 03 00 00 01 03 00 00 00 00 00 00 00
					39 01 00 00 00 00 03 FF 3C 11
					39 01 00 00 00 00 4F B1 FF FF FF FF FF FF FF FF FF FB FF FF F9 FF FF F3 FF FC F0 FF FA EC FF F9 E7 FF F5 DA FF EF CB FF E9 B7 FF DE 9D FF CA 6F FF FF FF FF FF FF FF FF FF FF FF FF FF FF FF FF FF FF FF FF FF FF FF FF FF FF FF FF FF FF FF FF FF FF FF FF FF 00
					39 01 00 00 00 00 03 FF 3C 0B
					39 01 00 00 00 00 05 B3 01 01 00 B0
					39 01 00 00 05 00 02 70 00
					15 01 00 00 00 00 02 03 00
					39 01 00 00 00 00 05 2A 00 00 04 37
					39 01 00 00 00 00 05 2B 00 00 09 5F
					39 01 00 00 00 00 03 44 05 FF
					39 01 00 00 00 00 02 35 00
					39 01 00 00 00 00 03 4A FF 03
					39 01 00 00 00 00 03 4C FF 03
					39 01 00 00 00 00 03 51 FF 07
					39 01 00 00 00 00 02 53 21
					39 01 00 00 00 00 02 7B 01
					05 01 00 00 0A 00 02 11 00
					05 01 00 00 19 00 02 29 00
				];
				qcom,mdss-dsi-off-command = [
					05 01 00 00 14 00 02 28 00
					05 01 00 00 78 00 02 10 00
				];
				qcom,mdss-dsi-on-command-state = "dsi_lp_mode";
				qcom,mdss-dsi-off-command-state = "dsi_hs_mode";
			};
		};
	};
};
