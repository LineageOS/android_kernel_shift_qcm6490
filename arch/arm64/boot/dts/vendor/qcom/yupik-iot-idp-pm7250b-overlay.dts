/dts-v1/;
/plugin/;

#include "yupik-iot-idp-pm7250b.dtsi"

/ {
	model = "SHIFT SHIFTphone 8";
	compatible = "shift,otter", "qcom,yupik-iot-idp", "qcom,yupik-iot", "qcom,idp";
	qcom,msm-id = <497 0x10000>, <575 0x10000>, <576 0x10000>;
	qcom,board-id = <34 0>;
};
